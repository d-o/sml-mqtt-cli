## CMakeLists.txt
```
# Copyright (c) 2025 Dean Sellers (dean@sellers.id.au)
# SPDX-License-Identifier: MIT

cmake_minimum_required(VERSION 3.20.0)

find_package(Zephyr REQUIRED HINTS $ENV{ZEPHYR_BASE})
project(sml_mqtt_cli_test)

# Export compile_commands.json for IDE tooling (clangd, VS Code IntelliSense)
set(CMAKE_EXPORT_COMPILE_COMMANDS ON)

# Add test source files.
#
# Two mutually exclusive build configurations:
#
#   Default (qemu_riscv32, ESP32, any target without ETH_NATIVE_TAP):
#     Compiles the fake MQTT broker and all 20 loopback unit tests.
#     Network is entirely in-kernel (CONFIG_NET_TEST + CONFIG_NET_LOOPBACK).
#     No external broker or network hardware required.
#
#   native_sim (CONFIG_ETH_NATIVE_TAP=y):
#     Compiles only the integration test suite (sml_mqtt_integration).
#     Tests connect to a real MQTT broker via a TAP virtual Ethernet interface.
#     See tests/scripts/run_integration_tests.sh for setup.
#
#     Broker location is configured at build time via CMake cache variables:
#
#       SML_MQTT_TEST_BROKER_HOST  (default "192.0.2.1" = host-side TAP IP)
#       SML_MQTT_TEST_BROKER_PORT  (default 1883)
#
#     Use case 1 - broker on build machine (default):
#       west build -p always -s sml-mqtt-cli/tests -b native_sim \
#         -- -DZEPHYR_MODULES=...
#
#     Use case 2 - broker on LAN or remote host:
#       west build -p always -s sml-mqtt-cli/tests -b native_sim \
#         -- -DZEPHYR_MODULES=... \
#            -DSML_MQTT_TEST_BROKER_HOST="192.168.1.100" \
#            -DSML_MQTT_TEST_BROKER_PORT=1883
#       sudo tests/scripts/run_integration_tests.sh \
#         --broker-host 192.168.1.100 --enable-routing --no-local-broker

if(CONFIG_ETH_NATIVE_TAP)
  # Broker address injected as a compile-time macro.  Defaults to the host
  # side of the TAP interface (192.0.2.1) for the standard local-broker case.
  # Override with -DSML_MQTT_TEST_BROKER_HOST=<ip> to target a LAN or remote
  # broker without modifying source files.
  set(SML_MQTT_TEST_BROKER_HOST "192.0.2.1" CACHE STRING
      "Broker hostname/IP for integration tests (native_sim)")
  set(SML_MQTT_TEST_BROKER_PORT "1883" CACHE STRING
      "Broker TCP port for integration tests (native_sim)")

  message(STATUS "Integration test broker: "
          "${SML_MQTT_TEST_BROKER_HOST}:${SML_MQTT_TEST_BROKER_PORT}")

  # TLS broker port — separate cache variable so plaintext and TLS tests can
  # target different ports without rebuilding.
  set(SML_MQTT_TEST_TLS_PORT "8883" CACHE STRING
      "Broker TLS port for TLS integration tests (native_sim)")

  zephyr_compile_definitions(
      SML_MQTT_TEST_BROKER_HOST="${SML_MQTT_TEST_BROKER_HOST}"
      SML_MQTT_TEST_BROKER_PORT=${SML_MQTT_TEST_BROKER_PORT}
      SML_MQTT_TEST_TLS_PORT=${SML_MQTT_TEST_TLS_PORT}
  )

  target_sources(app PRIVATE
    src/main.cpp
    src/test_integration_broker.cpp
    src/test_tls_integration.cpp
  )
else()
  target_sources(app PRIVATE
    src/fake_broker.cpp
    src/main.cpp
    src/test_basic_connection.cpp
    src/test_publish_subscribe.cpp
    src/test_qos_levels.cpp
    src/test_multiple_clients.cpp
    src/test_concurrent_ops.cpp
    src/test_tls_config.cpp
  )
endif()

# Ensure we can find the header
zephyr_include_directories(../include)
```

## prj.conf
```kconfig
# Copyright (c) 2025 Dean Sellers (dean@sellers.id.au)
# SPDX-License-Identifier: MIT

# C++ support
CONFIG_CPP=y
CONFIG_STD_CPP17=y
CONFIG_REQUIRES_FULL_LIBCPP=y

# Boost.SML
CONFIG_LIB_BOOST_SML=y

# SML MQTT CLI
CONFIG_LIB_SML_MQTT_CLI=y

# Testing framework
CONFIG_ZTEST=y
CONFIG_ZTEST_STACK_SIZE=8192

# Networking (common to all targets)
# CONFIG_NET_TEST and CONFIG_NET_LOOPBACK are board-specific:
#   qemu_riscv32 / esp32s3: boards/<board>.conf enables both NET_TEST and
#   NET_LOOPBACK for the in-process fake broker (NET_TEST does not auto-select
#   NET_LOOPBACK).
#   native_sim: boards/native_sim.conf enables ETH_NATIVE_TAP instead.
CONFIG_NETWORKING=y
CONFIG_NET_DRIVERS=y

CONFIG_NET_IPV4=y
CONFIG_NET_TCP=y
CONFIG_NET_TCP_TIME_WAIT_DELAY=0
CONFIG_NET_SOCKETS=y

# MQTT
CONFIG_MQTT_LIB=y

# Logging
CONFIG_LOG=y
CONFIG_PRINTK=y

# System
CONFIG_MAIN_STACK_SIZE=8192
CONFIG_HEAP_MEM_POOL_SIZE=16384
# Each test needs 3 fds (server sock + accepted sock + client TCP); default=7 is too small.
CONFIG_ZVFS_OPEN_MAX=16

# Random for testing
CONFIG_ENTROPY_GENERATOR=y
CONFIG_TEST_RANDOM_GENERATOR=y
```

## prj_tls.conf
```kconfig
# Copyright (c) 2025 Dean Sellers (dean@sellers.id.au)
# SPDX-License-Identifier: MIT
#
# TLS overlay — layer on top of prj.conf to enable the TLS stack.
# Usage (build only, no handshake):
#   west build -p always -s sml-mqtt-cli/tests -b qemu_riscv32 \
#     -- -DZEPHYR_MODULES="$PWD/boost-sml;$PWD/sml-mqtt-cli" \
#        -DCONF_FILE="prj.conf;prj_tls.conf"

# MQTT TLS transport
CONFIG_MQTT_LIB_TLS=y

# TLS socket layer — NET_SOCKETS_SOCKOPT_TLS automatically selects MBEDTLS
# (via NET_NATIVE) and implies MBEDTLS_SSL_PROTO_TLS1_2, MBEDTLS_RSA_C,
# MBEDTLS_KEY_EXCHANGE_RSA_ENABLED, etc.  No need to set them explicitly.
CONFIG_NET_SOCKETS_SOCKOPT_TLS=y
CONFIG_TLS_CREDENTIALS=y

# mbedTLS needs roughly 30-60 KB of heap for a TLS handshake.
# Increase from the prj.conf default of 16384.
CONFIG_HEAP_MEM_POOL_SIZE=65536

# NET_SLIP_TAP defaults to y on any QEMU_TARGET unless NET_TEST is set.
# Without this, SLIP -> UART_PIPE gets pulled in and the build fails
# because qemu_riscv32 has no zephyr,uart-pipe DTS chosen node.
# boards/qemu_riscv32.conf sets this, but is not merged when CONF_FILE
# is overridden explicitly via -DCONF_FILE="prj.conf;prj_tls.conf".
CONFIG_NET_TEST=y
CONFIG_NET_LOOPBACK=y
```

## boards/esp32s3_devkitc_procpu.conf
```kconfig
# Copyright (c) 2026 Dean Sellers (dean@sellers.id.au)
# SPDX-License-Identifier: MIT
#
# ESP32-S3 stack size overrides for the sml-mqtt-cli test suite.
#
# Xtensa LX7 (ESP32-S3) has a larger per-frame ABI cost than the
# RISC-V target used in CI (qemu_riscv32).  The Zephyr networking
# threads that the test suite exercises (TCP work queue, RX queue,
# net_mgmt event thread) overflow with their default 1-2 KB stacks
# because the gcov / networking code paths are deeper on Xtensa.
#
# These values match the minimums found by trial and observation;
# the Zephyr net tests for ESP32 use similar sizes.

# TCP work queue thread (1024 default, overflows on Xtensa with
# active TCP sockets and C++ exception unwind tables present)
CONFIG_NET_TCP_WORKQ_STACK_SIZE=4096

# Enable the built-in USB-JTAG CDC-ACM serial driver so that the DTS
# overlay can redirect zephyr,console to &usb_serial (ttyACM0).
# Without this the uart_console driver fails to compile because the
# __device_dts_ord for usb_serial is never declared.
CONFIG_SERIAL_ESP32_USB=y

# In-kernel loopback for the fake-broker unit test suite.
# CONFIG_NET_LOOPBACK must be set explicitly - NET_TEST does not select it.
CONFIG_NET_TEST=y
CONFIG_NET_LOOPBACK=y
```

## boards/native_sim.conf
```kconfig
# Copyright (c) 2026 Dean Sellers (dean@sellers.id.au)
# SPDX-License-Identifier: MIT
#
# native_sim board config for sml-mqtt-cli INTEGRATION tests.
#
# Builds the sml_mqtt_integration suite which connects to a real Mosquitto
# broker running on the build host via a TAP virtual Ethernet interface.
# None of the fake-broker loopback tests are compiled in this configuration.
#
# IP assignment:
#   Zephyr app (this binary)  -> 192.0.2.2/24
#   Host TAP interface        -> 192.0.2.1/24  (set by setup_tap.sh)
#   Mosquitto listens on      -> 192.0.2.1:1883
#
# Prerequisites (run once before the binary):
#   tests/scripts/run_integration_tests.sh
#
# Or manually:
#   sudo ip tuntap add zeth0 mode tap user $USER
#   sudo ip addr add 192.0.2.1/24 dev zeth0
#   sudo ip link set zeth0 up
#   mosquitto -c tests/scripts/mosquitto_integration.conf &
#   ./build/zephyr/zephyr.exe

# TAP virtual Ethernet driver (native_sim only)
CONFIG_ETH_NATIVE_TAP=y

# Slow execution to real time so network timers fire correctly
CONFIG_NATIVE_SIM_SLOWDOWN_TO_REAL_TIME=y

# Static IPv4 configuration applied automatically by net_config on boot
CONFIG_NET_CONFIG_SETTINGS=y
CONFIG_NET_CONFIG_NEED_IPV4=y
CONFIG_NET_CONFIG_MY_IPV4_ADDR="192.0.2.2"
CONFIG_NET_CONFIG_MY_IPV4_NETMASK="255.255.255.0"
CONFIG_NET_CONFIG_MY_IPV4_GW="192.0.2.1"

# Allow up to 10 s for the TAP interface to come up
CONFIG_NET_CONFIG_INIT_TIMEOUT=10
```

## boards/qemu_riscv32.conf
```kconfig
# Copyright (c) 2026 Dean Sellers (dean@sellers.id.au)
# SPDX-License-Identifier: MIT
#
# qemu_riscv32 board config for the sml-mqtt-cli test suite.
#
# Enables Zephyr's in-kernel loopback networking so the fake broker and
# all 20 unit tests can run inside QEMU with no external broker.
#
# CONFIG_NET_TEST enables in-kernel loopback test mode.
# CONFIG_NET_LOOPBACK must be set explicitly - NET_TEST does not select it.

CONFIG_NET_TEST=y
CONFIG_NET_LOOPBACK=y
```

## boards/esp32s3_devkitc_procpu.overlay
```dts
/*
 * Copyright (c) 2026 Dean Sellers (dean@sellers.id.au)
 * SPDX-License-Identifier: MIT
 *
 * Redirect the Zephyr console from uart0 (GPIO43/44 -> USB-UART bridge ->
 * ttyUSB0) to the built-in USB-JTAG CDC-ACM interface (ttyACM0) so that
 * test output is visible on a single USB cable without needing the separate
 * UART bridge port.
 *
 * The board DTS disables usb_serial by default; re-enable it here.
 */

&usb_serial {
	status = "okay";
};

/ {
	chosen {
		zephyr,console = &usb_serial;
		zephyr,shell-uart = &usb_serial;
	};
};
```

## src/main.cpp
```c
/*
 * Copyright (c) 2025 Dean Sellers (dean@sellers.id.au)
 * SPDX-License-Identifier: MIT
 */

#include <zephyr/ztest.h>
#include <zephyr/kernel.h>
#include <zephyr/net/socket.h>
#include <zephyr/net/mqtt.h>
#include <sml-mqtt-cli.hpp>

/*
 * fake_broker.hpp is only compiled in the loopback build (qemu / ESP32).
 * For native_sim integration builds (CONFIG_ETH_NATIVE_TAP), the fake broker
 * is not linked and its header must not be included.
 */
#if !defined(CONFIG_ETH_NATIVE_TAP)
#include "fake_broker.hpp"
#endif

/**
 * @brief Poll the client socket then call mqtt_input().
 *
 * Works for both loopback (fake broker) and real-network (native_sim) builds.
 * The caller should loop this function with appropriate timeouts; it returns
 * after no further data arrives within the current poll window.
 *
 * For loopback tests: call after every fake_broker_process() to let the SML
 * client process the response the broker just sent.
 *
 * For integration tests: call in a loop alongside mqtt_live() until the
 * expected state transition completes.
 *
 * @param client  Reference to the sml_mqtt_cli::mqtt_client instance.
 */
void client_poll_and_input(sml_mqtt_cli::mqtt_client &client)
{
	int fd = client.get_context().client.transport.tcp.sock;

	if (fd < 0) {
		return;
	}

	struct zsock_pollfd pfd = {
		.fd      = fd,
		.events  = ZSOCK_POLLIN,
		.revents = 0,
	};

	/*
	 * Zephyr's TCP layer can deliver a multi-byte packet in multiple
	 * fragments.  Loop: wait up to 200 ms for data, call mqtt_input(),
	 * then immediately check if more data has arrived (50 ms timeout).
	 * Stop when no further data comes in.
	 */
	int timeout_ms = 200;

	while (true) {
		pfd.revents = 0;
		int ret = zsock_poll(&pfd, 1, timeout_ms);

		if (ret <= 0 || !(pfd.revents & ZSOCK_POLLIN)) {
			break;
		}

		mqtt_input(&client.get_context().client);

		/* Switch to short timeout for subsequent fragments. */
		timeout_ms = 50;
	}
}

/* -------------------------------------------------------------------------
 * Loopback suite registrations (qemu_riscv32 / ESP32 only).
 *
 * Each loopback test gets a clean fake broker instance via before/after hooks.
 * These are omitted for native_sim integration builds where fake_broker.cpp
 * is not compiled; the integration suite registers itself in
 * test_integration_broker.cpp.
 * ------------------------------------------------------------------------- */

#if !defined(CONFIG_ETH_NATIVE_TAP)

static void broker_before(void *fixture)
{
	ARG_UNUSED(fixture);
	fake_broker_init();
}

static void broker_after(void *fixture)
{
	ARG_UNUSED(fixture);
	fake_broker_destroy();
}

ZTEST_SUITE(sml_mqtt_basic,       NULL, NULL, broker_before, broker_after, NULL);
ZTEST_SUITE(sml_mqtt_pubsub,      NULL, NULL, broker_before, broker_after, NULL);
ZTEST_SUITE(sml_mqtt_qos,         NULL, NULL, broker_before, broker_after, NULL);
ZTEST_SUITE(sml_mqtt_multiple,    NULL, NULL, broker_before, broker_after, NULL);
ZTEST_SUITE(sml_mqtt_concurrent,  NULL, NULL, broker_before, broker_after, NULL);
/* TLS config tests do not use the fake broker (all paths return before
 * mqtt_connect() is called, or check context fields set by init()). */
ZTEST_SUITE(sml_mqtt_tls,         NULL, NULL, NULL,          NULL,         NULL);

#endif /* !CONFIG_ETH_NATIVE_TAP */
```

## src/fake_broker.cpp
```c
/*
 * Copyright (c) 2026 Dean Sellers (dean@sellers.id.au)
 * SPDX-License-Identifier: MIT
 *
 * fake_broker.cpp - In-process MQTT 3.1.1 fake broker for Zephyr loopback tests.
 *
 * Modelled after zephyr/tests/net/lib/mqtt/v3_1_1/mqtt_client/src/main.c
 *
 * The broker is entirely poll-driven: the caller drives I/O by interleaving
 *   fake_broker_process(EXPECTED_TYPE)  ->  mqtt_input(client)
 * calls.  No threads, no semaphores, no heap.
 */

#include "fake_broker.hpp"

#include <zephyr/kernel.h>
#include <zephyr/ztest.h>
#include <zephyr/net/socket.h>
#include <cerrno>
#include <cstring>

/* -------------------------------------------------------------------------
 * Internal constants
 * ------------------------------------------------------------------------- */

#define BROKER_BUF_SIZE    1500   /* max MQTT packet we expect in tests */
#define BROKER_TOPIC_MAX   128    /* max subscription topic length */
#define BROKER_TIMEOUT_MS  100    /* poll timeout per iteration */

/* -------------------------------------------------------------------------
 * Static broker state (one instance, no heap)
 * ------------------------------------------------------------------------- */

static int      s_sock = -1;                       /* server (listen) socket  */
static int      c_sock = -1;                       /* accepted client socket  */
static uint8_t  broker_buf[BROKER_BUF_SIZE];       /* accumulation buffer     */
static size_t   broker_offset = 0;                 /* valid bytes in buf      */
static char     broker_topic[BROKER_TOPIC_MAX];    /* topic from SUBSCRIBE    */
static bool     s_no_response = false;             /* set by fake_broker_absorb */

/* -------------------------------------------------------------------------
 * Pre-built fixed-length response packets
 * ------------------------------------------------------------------------- */

/* CONNACK: type=0x20, remaining=2, return_code=0, session_present=0 */
static const uint8_t resp_connack[]  = { 0x20u, 0x02u, 0x00u, 0x00u };

/* PINGRESP: type=0xD0, remaining=0 */
static const uint8_t resp_pingresp[] = { 0xD0u, 0x00u };

/* -------------------------------------------------------------------------
 * Internal helpers
 * ------------------------------------------------------------------------- */

/** Send all bytes in buf to the connected client socket. */
static void broker_send(const uint8_t *data, size_t len)
{
	while (len > 0u) {
		ssize_t n = zsock_send(c_sock, data, len, 0);
		zassert_true(n > 0, "fake_broker: send failed (errno %d)", errno);
		data += n;
		len  -= (size_t)n;
	}
}

/**
 * Encode and send an MQTT fixed header.
 *
 * @param type_byte     Full first byte (type|flags) already formed by caller.
 * @param remaining_len Value to encode in the variable-length field.
 */
static void send_fixed_header(uint8_t type_byte, uint32_t remaining_len)
{
	uint8_t buf[5];
	size_t  pos = 0u;

	buf[pos++] = type_byte;

	/* Variable-length remaining length encoding (MQTT 3.1.1 §2.2.3) */
	uint32_t rl = remaining_len;
	do {
		uint8_t enc = (uint8_t)(rl & 0x7Fu);
		rl >>= 7;
		if (rl > 0u) {
			enc |= 0x80u;
		}
		buf[pos++] = enc;
	} while (rl > 0u);

	broker_send(buf, pos);
}

/* -------------------------------------------------------------------------
 * Packet dispatcher
 *
 * Called once a full packet has been decoded from broker_buf.
 * var_hdr points to the variable header (first byte after fixed header).
 * remaining_len is the remaining length field value.
 * type_byte is the full first byte of the fixed header.
 * ------------------------------------------------------------------------- */

static void dispatch_packet(uint8_t type_byte,
			    const uint8_t *var_hdr,
			    uint32_t remaining_len)
{
	/* fake_broker_absorb() sets this flag to suppress the normal response. */
	if (s_no_response) {
		s_no_response = false;
		return;
	}

	uint8_t type  = type_byte & 0xF0u;
	uint8_t flags = type_byte & 0x0Fu;

	switch (type) {

	/* ---- CONNECT (0x10) ------------------------------------------- */
	case 0x10u:
		broker_send(resp_connack, sizeof(resp_connack));
		break;

	/* ---- PUBLISH (0x30) ------------------------------------------- */
	case 0x30u: {
		uint8_t  qos       = (flags >> 1u) & 0x03u;
		uint16_t topic_len = ((uint16_t)var_hdr[0] << 8u) | var_hdr[1];

		/* Packet identifier is present for QoS 1 and QoS 2 only. */
		const uint8_t *pkt_id = var_hdr + 2u + topic_len;

		if (qos == 1u) {
			/* PUBACK: type=0x40, remaining=2, packet_id */
			uint8_t puback[4] = {
				0x40u, 0x02u, pkt_id[0], pkt_id[1]
			};
			broker_send(puback, sizeof(puback));
		} else if (qos == 2u) {
			/* PUBREC: type=0x50, remaining=2, packet_id */
			uint8_t pubrec[4] = {
				0x50u, 0x02u, pkt_id[0], pkt_id[1]
			};
			broker_send(pubrec, sizeof(pubrec));
		}

		/* Echo the publish back if topic matches active subscription.
		 * This is the mechanism that makes the loopback pubsub test
		 * work: subscribe + publish on one client, broker echoes back. */
		if (topic_len > 0u &&
		    topic_len < BROKER_TOPIC_MAX &&
		    broker_topic[0] != '\0' &&
		    topic_len == (uint16_t)strlen(broker_topic) &&
		    memcmp(var_hdr + 2u, broker_topic, topic_len) == 0) {
			send_fixed_header(type_byte, remaining_len);
			broker_send(var_hdr, remaining_len);
		}
		break;
	}

	/* ---- PUBREL (0x62 on wire, type nibble = 0x60) ----------------- */
	case 0x60u: {
		/* PUBCOMP: type=0x70, remaining=2, echo packet_id */
		uint8_t pubcomp[4] = {
			0x70u, 0x02u, var_hdr[0], var_hdr[1]
		};
		broker_send(pubcomp, sizeof(pubcomp));
		break;
	}

	/* ---- SUBSCRIBE (0x82 on wire, type nibble = 0x80) -------------- */
	case 0x80u: {
		/* Variable header: [pkt_id_hi, pkt_id_lo]
		 * Payload per topic: [topic_len_hi, topic_len_lo, topic..., qos] */
		uint16_t topic_len = ((uint16_t)var_hdr[2] << 8u) | var_hdr[3];
		uint8_t  granted   = (topic_len < BROKER_TOPIC_MAX)
					? var_hdr[4u + topic_len] : 0u;

		if (topic_len > 0u && topic_len < BROKER_TOPIC_MAX) {
			memcpy(broker_topic, var_hdr + 4u, topic_len);
			broker_topic[topic_len] = '\0';
		}

		/* SUBACK: type=0x90, remaining=3, packet_id, granted_qos */
		uint8_t suback[5] = {
			0x90u, 0x03u,
			var_hdr[0], var_hdr[1],
			granted
		};
		broker_send(suback, sizeof(suback));
		break;
	}

	/* ---- UNSUBSCRIBE (0xA2 on wire, type nibble = 0xA0) ------------ */
	case 0xA0u: {
		memset(broker_topic, 0, sizeof(broker_topic));

		/* UNSUBACK: type=0xB0, remaining=2, echo packet_id */
		uint8_t unsuback[4] = {
			0xB0u, 0x02u, var_hdr[0], var_hdr[1]
		};
		broker_send(unsuback, sizeof(unsuback));
		break;
	}

	/* ---- PINGREQ (0xC0) ------------------------------------------- */
	case 0xC0u:
		broker_send(resp_pingresp, sizeof(resp_pingresp));
		break;

	/* ---- DISCONNECT (0xE0) ---------------------------------------- */
	case 0xE0u:
		zsock_close(c_sock);
		c_sock = -1;
		break;

	default:
		zassert_unreachable("fake_broker: unhandled packet type 0x%02x",
				    type);
		break;
	}
}

/* -------------------------------------------------------------------------
 * Packet receiver
 *
 * Attempts a non-blocking read from c_sock into broker_buf, then tries to
 * decode and dispatch one complete MQTT packet.
 *
 * Returns:
 *   0       - one packet successfully processed
 *  -EAGAIN  - not enough data yet (caller should poll and retry)
 * ------------------------------------------------------------------------- */

static int broker_receive(uint8_t expected_type)
{
	zassert_false(broker_offset == sizeof(broker_buf),
		      "fake_broker: receive buffer full");

	ssize_t n = zsock_recv(c_sock,
			       broker_buf + broker_offset,
			       sizeof(broker_buf) - broker_offset,
			       ZSOCK_MSG_DONTWAIT);

	if (n > 0) {
		broker_offset += (size_t)n;
	} else if (n == 0) {
		/* Connection closed by client (e.g. after DISCONNECT). */
		return -EAGAIN;
	} else if (n < 0 && errno != EAGAIN) {
		zassert_unreachable("fake_broker: recv error (errno %d)", errno);
	}

	/* Need at least the first byte (type+flags) and one length byte. */
	if (broker_offset < 2u) {
		return -EAGAIN;
	}

	/* Decode variable-length remaining length (MQTT 3.1.1 §2.2.3).
	 * Each byte: lower 7 bits = value, bit 7 = more bytes follow. */
	uint32_t remaining_len = 0u;
	uint32_t multiplier    = 1u;
	size_t   hdr_end       = 1u;  /* index of first byte past fixed header */

	do {
		if (hdr_end >= broker_offset) {
			return -EAGAIN;  /* partial header */
		}

		uint8_t enc = broker_buf[hdr_end++];

		remaining_len += (uint32_t)(enc & 0x7Fu) * multiplier;
		multiplier    <<= 7;

		if (multiplier > (128u * 128u * 128u)) {
			zassert_unreachable(
				"fake_broker: malformed remaining-length field");
		}

		if (!(enc & 0x80u)) {
			break;  /* this was the last length byte */
		}
	} while (true);

	/* Require the full packet body to be present. */
	size_t total = hdr_end + (size_t)remaining_len;

	if (broker_offset < total) {
		return -EAGAIN;  /* partial packet body */
	}

	/* Validate packet type (upper nibble matches expected). */
	uint8_t type_byte     = broker_buf[0];
	uint8_t received_type = type_byte & 0xF0u;

	zassert_equal(received_type, expected_type & 0xF0u,
		      "fake_broker: expected packet type 0x%02x, got 0x%02x",
		      (unsigned)(expected_type & 0xF0u),
		      (unsigned)received_type);

	/* Dispatch - var_hdr points into broker_buf immediately after the
	 * fixed header.  The buffer is not shifted until after dispatch so
	 * that the echo path in PUBLISH can reference the original bytes. */
	dispatch_packet(type_byte, broker_buf + hdr_end, remaining_len);

	/* Consume the processed packet from the buffer. */
	broker_offset -= total;
	if (broker_offset > 0u) {
		memmove(broker_buf, broker_buf + total, broker_offset);
	}

	return 0;
}

/* -------------------------------------------------------------------------
 * Public API
 * ------------------------------------------------------------------------- */

void fake_broker_init(void)
{
	struct sockaddr_in bind_addr = {};
	int opt = 1;
	int ret;

	memset(broker_topic, 0, sizeof(broker_topic));
	broker_offset = 0;

	bind_addr.sin_family      = AF_INET;
	bind_addr.sin_port        = htons(FAKE_BROKER_PORT);
	/* sin_addr.s_addr = INADDR_ANY (0) - zero-init above */

	s_sock = zsock_socket(AF_INET, SOCK_STREAM, IPPROTO_TCP);
	zassert_true(s_sock >= 0,
		     "fake_broker_init: socket() failed (errno %d)", errno);

	ret = zsock_setsockopt(s_sock, SOL_SOCKET, SO_REUSEADDR,
			       &opt, sizeof(opt));
	zassert_ok(ret,
		   "fake_broker_init: SO_REUSEADDR failed (errno %d)", errno);

	ret = zsock_bind(s_sock, (struct sockaddr *)&bind_addr,
			 sizeof(bind_addr));
	zassert_ok(ret,
		   "fake_broker_init: bind() failed (errno %d)", errno);

	ret = zsock_listen(s_sock, 1);
	zassert_ok(ret,
		   "fake_broker_init: listen() failed (errno %d)", errno);
}

void fake_broker_destroy(void)
{
	if (c_sock >= 0) {
		zsock_close(c_sock);
		c_sock = -1;
	}
	if (s_sock >= 0) {
		zsock_close(s_sock);
		s_sock = -1;
	}
	memset(broker_topic, 0, sizeof(broker_topic));
	broker_offset = 0;

	/* Allow the TCP stack to release TIME_WAIT resources. */
	k_msleep(10);
}

/* QoS bits live at [2:1] of the PUBLISH fixed-header byte (MQTT 3.1.1 §3.3.1). */
static void send_publish_packet(uint8_t qos, uint16_t msg_id,
				const char *topic, const uint8_t *payload,
				size_t len)
{
	uint16_t topic_len = (uint16_t)strlen(topic);
	uint8_t  type_byte = (uint8_t)(0x30u | ((uint8_t)qos << 1u));
	uint32_t remaining = 2u + (uint32_t)topic_len
			   + (qos != 0u ? 2u : 0u)
			   + (uint32_t)len;

	send_fixed_header(type_byte, remaining);

	uint8_t tlen[2] = {
		(uint8_t)(topic_len >> 8u),
		(uint8_t)(topic_len & 0xFFu)
	};
	broker_send(tlen, 2u);
	broker_send((const uint8_t *)topic, topic_len);

	if (qos != 0u) {
		uint8_t pid[2] = {
			(uint8_t)(msg_id >> 8u),
			(uint8_t)(msg_id & 0xFFu)
		};
		broker_send(pid, 2u);
	}

	if (payload != NULL && len > 0u) {
		broker_send(payload, len);
	}
}

void fake_broker_send_qos0_publish(const char *topic, const uint8_t *payload,
				   size_t len)
{
	zassert_true(c_sock >= 0, "fake_broker_send_qos0_publish: no client connected");
	zassert_not_null(topic, "fake_broker_send_qos0_publish: topic is NULL");
	send_publish_packet(0u, 0u, topic, payload, len);
}

void fake_broker_send_qos1_publish(const char *topic, const uint8_t *payload,
				   size_t len, uint16_t msg_id)
{
	zassert_true(c_sock >= 0, "fake_broker_send_qos1_publish: no client connected");
	zassert_not_null(topic, "fake_broker_send_qos1_publish: topic is NULL");
	zassert_true(msg_id != 0u, "fake_broker_send_qos1_publish: msg_id must be non-zero");
	send_publish_packet(1u, msg_id, topic, payload, len);
}

void fake_broker_absorb(uint8_t expected_type)
{
	s_no_response = true;
	fake_broker_process(expected_type);
}

void fake_broker_send_qos2_publish(const char *topic, const uint8_t *payload,
				   size_t len, uint16_t msg_id)
{
	zassert_true(c_sock >= 0, "fake_broker_send_qos2_publish: no client connected");
	zassert_not_null(topic, "fake_broker_send_qos2_publish: topic is NULL");
	zassert_true(msg_id != 0u, "fake_broker_send_qos2_publish: msg_id must be non-zero");
	send_publish_packet(2u, msg_id, topic, payload, len);
}

void fake_broker_process(uint8_t expected_type)
{
	struct zsock_pollfd fds[2] = {
		{ .fd = s_sock, .events = ZSOCK_POLLIN, .revents = 0 },
		{ .fd = c_sock, .events = ZSOCK_POLLIN, .revents = 0 },
	};

	/* Fast path: already have buffered data and a live connection. */
	if (c_sock >= 0 && broker_offset > 0u) {
		if (broker_receive(expected_type) == 0) {
			return;
		}
	}

	while (true) {
		fds[0].revents = 0;
		fds[1].revents = 0;
		fds[1].fd      = c_sock;  /* refresh in case accept() ran */

		int ret = zsock_poll(fds, ARRAY_SIZE(fds), BROKER_TIMEOUT_MS);

		zassert_true(ret > 0,
			     "fake_broker_process: poll timeout "
			     "waiting for packet type 0x%02x",
			     (unsigned)expected_type);

		for (int i = 0; i < 2; i++) {
			if (fds[i].fd < 0 ||
			    !(fds[i].revents & ZSOCK_POLLIN)) {
				continue;
			}

			if (i == 0) {
				/* New TCP connection from client. */
				zassert_equal(c_sock, -1,
					      "fake_broker_process: "
					      "unexpected second connection");
				c_sock = zsock_accept(s_sock, NULL, NULL);
				zassert_true(
					c_sock >= 0,
					"fake_broker_process: accept() failed "
					"(errno %d)", errno);
				fds[1].fd = c_sock;
			} else {
				/* Data from the connected client. */
				if (broker_receive(expected_type) == 0) {
					return;
				}
			}
		}
	}
}
```

## src/fake_broker.hpp
```c
/*
 * Copyright (c) 2026 Dean Sellers (dean@sellers.id.au)
 * SPDX-License-Identifier: MIT
 *
 * fake_broker.hpp - In-process MQTT 3.1.1 fake broker for Zephyr loopback tests.
 *
 * Modelled after zephyr/tests/net/lib/mqtt/v3_1_1/mqtt_client/src/main.c
 *
 * Approach: poll-driven, no broker thread.  The test function interleaves
 *   fake_broker_process(EXPECTED_TYPE)  ->  client_poll_and_input()
 * for each protocol round-trip.  This is the same pattern used by Zephyr's
 * own CI for the upstream mqtt_client tests.
 *
 * Constraints:
 *   - IPv4 / 127.0.0.1:FAKE_BROKER_PORT only
 *   - Single simultaneous client connection
 *   - Static storage, no heap
 */

#ifndef FAKE_BROKER_HPP
#define FAKE_BROKER_HPP

#include <cstdint>
#include <stddef.h>

/* -------------------------------------------------------------------------
 * MQTT 3.1.1 wire-format packet type constants (upper nibble only).
 * Defined locally to avoid including private Zephyr MQTT internals.
 * Values match MQTT 3.1.1 specification table 2.1.
 * ------------------------------------------------------------------------- */
#define FAKE_MQTT_PKT_CONNECT     UINT8_C(0x10)
#define FAKE_MQTT_PKT_CONNACK     UINT8_C(0x20)
#define FAKE_MQTT_PKT_PUBLISH     UINT8_C(0x30)
#define FAKE_MQTT_PKT_PUBACK      UINT8_C(0x40)
#define FAKE_MQTT_PKT_PUBREC      UINT8_C(0x50)
#define FAKE_MQTT_PKT_PUBREL      UINT8_C(0x60)
#define FAKE_MQTT_PKT_PUBCOMP     UINT8_C(0x70)
#define FAKE_MQTT_PKT_SUBSCRIBE   UINT8_C(0x80)
#define FAKE_MQTT_PKT_SUBACK      UINT8_C(0x90)
#define FAKE_MQTT_PKT_UNSUBSCRIBE UINT8_C(0xA0)
#define FAKE_MQTT_PKT_UNSUBACK    UINT8_C(0xB0)
#define FAKE_MQTT_PKT_PINGREQ     UINT8_C(0xC0)
#define FAKE_MQTT_PKT_PINGRSP     UINT8_C(0xD0)
#define FAKE_MQTT_PKT_DISCONNECT  UINT8_C(0xE0)

/** TCP port the fake broker listens on. */
#define FAKE_BROKER_PORT          1883

#ifdef __cplusplus
extern "C" {
#endif

/**
 * @brief Initialize the fake broker.
 *
 * Creates a TCP server socket, binds to 0.0.0.0:FAKE_BROKER_PORT, and
 * calls listen().  The accept() is deferred to the first
 * fake_broker_process() call.
 *
 * Call once per test (e.g. in a ztest before hook).
 * Triggers a zassert failure on any socket error.
 */
void fake_broker_init(void);

/**
 * @brief Destroy the fake broker.
 *
 * Closes both the server and client sockets and resets all internal state.
 * Call at the end of each test (e.g. in a ztest after hook).
 */
void fake_broker_destroy(void);

/**
 * @brief Drive one round of broker I/O.
 *
 * Blocks (via zsock_poll) until one complete MQTT packet arrives from the
 * client, validates its type, then responds per the MQTT 3.1.1 protocol:
 *
 *   CONNECT     -> sends CONNACK (return code 0, no session present)
 *   SUBSCRIBE   -> stores topic, sends SUBACK (granted QoS = requested)
 *   UNSUBSCRIBE -> clears stored topic, sends UNSUBACK
 *   PUBLISH     -> sends PUBACK (QoS 1) or PUBREC (QoS 2) if applicable;
 *                  if topic matches the stored subscription, echoes the
 *                  full PUBLISH packet back to the client
 *   PUBREL      -> sends PUBCOMP
 *   PINGREQ     -> sends PINGRESP
 *   DISCONNECT  -> closes client socket
 *
 * @param expected_type  One of the FAKE_MQTT_PKT_* constants.
 *                       Triggers a zassert failure if the received packet
 *                       type (upper nibble) does not match.
 */
void fake_broker_process(uint8_t expected_type);

/**
 * @brief Receive one packet from the client but suppress the normal response.
 *
 * Identical to fake_broker_process() except no reply is sent back.  Use this
 * to simulate a broker that receives a PUBLISH/PUBREL/PUBREC but never ACKs,
 * leaving the client's QoS state machine waiting indefinitely — useful for
 * testing the per-operation timeout path.
 *
 * @param expected_type  One of the FAKE_MQTT_PKT_* constants.
 */
void fake_broker_absorb(uint8_t expected_type);

/**
 * @brief Send a QoS 0 PUBLISH packet from the broker to the client.
 *
 * The client's next mqtt_input() call will process the packet, invoke the
 * publish_received callback, and fire evt_receive_done (no ACK required for
 * QoS 0 — the client sends nothing back to the broker).
 *
 * @param topic      Topic string (null-terminated).
 * @param payload    Payload bytes (may be NULL if len == 0).
 * @param len        Payload length in bytes.
 */
void fake_broker_send_qos0_publish(const char *topic, const uint8_t *payload,
                                   size_t len);

/**
 * @brief Send a QoS 1 PUBLISH packet from the broker to the client.
 *
 * The client's next mqtt_input() call will process the packet, send PUBACK
 * back to the broker, invoke the publish_received callback, and fire
 * evt_receive_done.  The broker must read the PUBACK from its socket
 * (e.g. via fake_broker_absorb(FAKE_MQTT_PKT_PUBACK)).
 *
 * @param topic      Topic string (null-terminated).
 * @param payload    Payload bytes (may be NULL if len == 0).
 * @param len        Payload length in bytes.
 * @param msg_id     Packet identifier (must be non-zero for QoS 1).
 */
void fake_broker_send_qos1_publish(const char *topic, const uint8_t *payload,
                                   size_t len, uint16_t msg_id);

/**
 * @brief Send a QoS 2 PUBLISH packet from the broker to the client.
 *
 * Builds and transmits a well-formed MQTT 3.1.1 PUBLISH packet with QoS 2
 * directly to the connected client socket.  The client's next mqtt_input()
 * call will process the packet, send PUBREC, and enter the waiting_rel state.
 *
 * @param topic      Topic string (null-terminated).
 * @param payload    Payload bytes (may be NULL if len == 0).
 * @param len        Payload length in bytes.
 * @param msg_id     Packet identifier (must be non-zero for QoS 2).
 */
void fake_broker_send_qos2_publish(const char *topic, const uint8_t *payload,
                                   size_t len, uint16_t msg_id);

#ifdef __cplusplus
}
#endif

#endif /* FAKE_BROKER_HPP */
```

## src/test_concurrent_ops.cpp
```c
/*
 * Copyright (c) 2026 Dean Sellers (dean@sellers.id.au)
 * SPDX-License-Identifier: MIT
 */

/*
 * test_concurrent_ops.cpp — Split-event (evt_publish_done / evt_receive_done)
 * regression and interference tests.
 *
 * What we are verifying
 * ---------------------
 * Before the split-event fix, evt_transaction_done was shared by both
 * publishing_sm and receiving_sm.  An incoming QoS 0/1 message fires
 * evt_transaction_done (now evt_receive_done) to exit receiving_sm.  If the
 * outer SM was simultaneously in sml::state<publishing_sm>, the shared event
 * matched the publishing_sm exit transition and prematurely returned the SM to
 * "Connected", aborting the outgoing publish handshake.
 *
 * The fix splits the event into evt_publish_done (for the publish path) and
 * evt_receive_done (for the receive path).  The outer SM only matches each
 * event against the composite state it belongs to, so interference is
 * impossible.
 *
 * Note: the outer SM is still sequential — it can be in publishing_sm OR
 * receiving_sm at a time, not both.  What the fix prevents is an incoming
 * message's *completion signal* being misrouted to the publish path.
 *
 * Test interaction pattern (deterministic, no k_sleep for flow control)
 * ----------------------------------------------------------------------
 *   fake_broker_send_qos0_publish(...)   — broker pushes a QoS 0 PUBLISH to
 *                                          the client over the loopback socket
 *   client_poll_and_input(client)        — client reads + processes the message
 *   fake_broker_process(EXPECTED_TYPE)   — broker reads + ACKs a client packet
 */

#include <zephyr/ztest.h>
#include <zephyr/kernel.h>
#include "fake_broker.hpp"
#include <sml-mqtt-cli.hpp>

extern void client_poll_and_input(sml_mqtt_cli::mqtt_client &client);

/* -------------------------------------------------------------------------
 * Test-local helpers
 * ------------------------------------------------------------------------- */

static volatile int s_rx_count;

static void on_publish_received(void *user_data,
                                const char *topic, const uint8_t *payload,
                                size_t len, enum mqtt_qos qos)
{
	ARG_UNUSED(user_data);
	ARG_UNUSED(topic);
	ARG_UNUSED(payload);
	ARG_UNUSED(len);
	ARG_UNUSED(qos);
	s_rx_count++;
}

static void connect_client(sml_mqtt_cli::mqtt_client &client, const char *id)
{
	s_rx_count = 0;
	client.set_publish_received_callback(on_publish_received, nullptr);

	int ret = client.init(id);
	zassert_equal(ret, 0, "init failed: %d", ret);

	ret = client.connect("127.0.0.1", FAKE_BROKER_PORT, false);
	zassert_equal(ret, 0, "connect failed: %d", ret);

	fake_broker_process(FAKE_MQTT_PKT_CONNECT);
	client_poll_and_input(client);
	zassert_true(client.is_connected(), "should be connected");
}

static void disconnect_client(sml_mqtt_cli::mqtt_client &client)
{
	client.disconnect();
	fake_broker_process(FAKE_MQTT_PKT_DISCONNECT);
}

/* -------------------------------------------------------------------------
 * sml_mqtt_concurrent test suite
 * ------------------------------------------------------------------------- */

/**
 * Core regression: incoming QoS 0 while outgoing QoS 1 is in progress.
 *
 * Before the fix: evt_transaction_done from the incoming QoS 0 receive matched
 * the sml::state<publishing_sm> exit transition and returned the SM to
 * "Connected" before PUBACK arrived — aborting the publish handshake.
 *
 * After the fix: evt_receive_done has no transition on publishing_sm; the SM
 * stays inside publishing_sm until PUBACK fires evt_publish_done.
 *
 * Sequence:
 *   1. Client sends QoS 1 PUBLISH → outer SM enters publishing_sm
 *   2. Broker injects QoS 0 PUBLISH to client (before sending PUBACK)
 *   3. client_poll_and_input → processes incoming QoS 0 → fires evt_receive_done
 *      (bug: would have exited publishing_sm; fix: event is ignored)
 *   4. Verify SM is NOT "Connected" yet (publish still in progress)
 *   5. fake_broker_process reads client's PUBLISH, sends PUBACK
 *   6. client_poll_and_input → PUBACK → evt_publish_done → SM = "Connected"
 */
ZTEST(sml_mqtt_concurrent, test_receive_qos0_during_publish_qos1)
{
	sml_mqtt_cli::mqtt_client client;
	connect_client(client, "test_conc_rx0_tx1");

	int ret = client.publish("test/conc/out/qos1",
				 reinterpret_cast<const uint8_t *>("hello"), 5,
				 MQTT_QOS_1_AT_LEAST_ONCE, false);
	zassert_equal(ret, 0, "QoS 1 publish failed: %d", ret);

	/* Broker injects an incoming QoS 0 message BEFORE processing the
	 * client's PUBLISH and sending PUBACK. */
	fake_broker_send_qos0_publish("test/conc/in/qos0",
				      reinterpret_cast<const uint8_t *>("ping"), 4);

	/* Client processes the incoming QoS 0.  evt_receive_done is fired.
	 * With the fix it must NOT exit publishing_sm. */
	client_poll_and_input(client);

	/* Receive callback must have fired exactly once. */
	zassert_equal(s_rx_count, 1, "publish_received callback must fire once");

	/* SM must still be tracking the outgoing QoS 1 — NOT back at Connected. */
	zassert_true(strcmp(client.get_state(), "Connected") != 0,
		     "SM must NOT return to Connected after evt_receive_done "
		     "while publish handshake is still in progress (bug: premature exit)");

	/* Now let the broker process the client's QoS 1 PUBLISH → sends PUBACK. */
	fake_broker_process(FAKE_MQTT_PKT_PUBLISH);
	client_poll_and_input(client);

	zassert_str_equal(client.get_state(), "Connected",
			  "SM must return to Connected after PUBACK");

	/* SM must be fully operational afterwards. */
	ret = client.subscribe("test/conc/out/qos1", MQTT_QOS_0_AT_MOST_ONCE);
	zassert_equal(ret, 0, "subscribe after concurrent ops failed: %d", ret);
	fake_broker_process(FAKE_MQTT_PKT_SUBSCRIBE);
	client_poll_and_input(client);
	zassert_str_equal(client.get_state(), "Connected",
			  "SM must be Connected after SUBACK");

	disconnect_client(client);
}

/**
 * Incoming QoS 0 during outgoing QoS 2, while waiting for PUBREC.
 *
 * The publish handshake is in its first phase (PUBLISH sent, awaiting PUBREC).
 * An incoming QoS 0 message fires evt_receive_done.  With the fix this must
 * not disturb the QoS 2 publish handshake.
 */
ZTEST(sml_mqtt_concurrent, test_receive_qos0_during_publish_qos2_waiting_pubrec)
{
	sml_mqtt_cli::mqtt_client client;
	connect_client(client, "test_conc_rx0_tx2a");

	int ret = client.publish("test/conc/out/qos2",
				 reinterpret_cast<const uint8_t *>("data"), 4,
				 MQTT_QOS_2_EXACTLY_ONCE, false);
	zassert_equal(ret, 0, "QoS 2 publish failed: %d", ret);

	/* Inject QoS 0 incoming before the broker sends PUBREC. */
	fake_broker_send_qos0_publish("test/conc/in/qos0b",
				      reinterpret_cast<const uint8_t *>("x"), 1);
	client_poll_and_input(client);

	zassert_equal(s_rx_count, 1, "receive callback fired once");
	zassert_true(strcmp(client.get_state(), "Connected") != 0,
		     "SM must NOT return to Connected — QoS 2 handshake in progress");

	/* Complete the QoS 2 handshake normally: PUBREC → PUBREL → PUBCOMP. */
	fake_broker_process(FAKE_MQTT_PKT_PUBLISH);   /* broker sends PUBREC */
	client_poll_and_input(client);                /* client sends PUBREL */
	fake_broker_process(FAKE_MQTT_PKT_PUBREL);    /* broker sends PUBCOMP */
	client_poll_and_input(client);                /* client processes PUBCOMP */

	zassert_str_equal(client.get_state(), "Connected",
			  "SM must be Connected after QoS 2 PUBCOMP");

	disconnect_client(client);
}

/**
 * Incoming QoS 0 during outgoing QoS 2 in releasing phase (waiting for PUBCOMP).
 *
 * PUBREC has arrived and PUBREL was sent.  The SM is now in publishing_sm's
 * "releasing" sub-state.  An incoming QoS 0 fires evt_receive_done.  With the
 * fix the SM stays in releasing; with the old bug it exits prematurely.
 */
ZTEST(sml_mqtt_concurrent, test_receive_qos0_during_publish_qos2_releasing)
{
	sml_mqtt_cli::mqtt_client client;
	connect_client(client, "test_conc_rx0_tx2b");

	int ret = client.publish("test/conc/out/qos2r",
				 reinterpret_cast<const uint8_t *>("data"), 4,
				 MQTT_QOS_2_EXACTLY_ONCE, false);
	zassert_equal(ret, 0, "QoS 2 publish failed: %d", ret);

	/* Step 1: let PUBREC arrive so the SM enters "releasing" state. */
	fake_broker_process(FAKE_MQTT_PKT_PUBLISH);   /* broker sends PUBREC */
	client_poll_and_input(client);                /* client processes PUBREC, sends PUBREL */

	/* Broker received PUBREL but hasn't sent PUBCOMP yet. */
	/* Inject QoS 0 incoming while SM is in "releasing" sub-state. */
	fake_broker_absorb(FAKE_MQTT_PKT_PUBREL);     /* consume PUBREL, suppress PUBCOMP */
	fake_broker_send_qos0_publish("test/conc/in/qos0c",
				      reinterpret_cast<const uint8_t *>("x"), 1);
	client_poll_and_input(client);                /* client processes incoming QoS 0 */

	zassert_equal(s_rx_count, 1, "receive callback fired once");
	zassert_true(strcmp(client.get_state(), "Connected") != 0,
		     "SM must NOT return to Connected — still in QoS 2 releasing state");

	/* Now manually send PUBCOMP to complete the handshake.
	 * Build a minimal PUBCOMP: type=0x70, remaining=2, pid=0x00 0x01
	 * (the client used pending_message_id=1 for the first publish). */

	/* We need to send PUBCOMP from broker to client.  Use the fake broker's
	 * internal helper by triggering a PUBREL response manually.  Since the
	 * fake_broker_absorb() already consumed the PUBREL without responding,
	 * we send a raw PUBCOMP packet directly via a second fake_broker
	 * helper — but none exists yet.  Instead, use the timeout mechanism:
	 * set a short timeout, sleep, call live() to drive SM back to Connected. */
	client.set_qos_timeout_ms(10);
	k_msleep(50);
	client.live();

	zassert_str_equal(client.get_state(), "Connected",
			  "SM must return to Connected via timeout after releasing state");

	disconnect_client(client);
}

/**
 * evt_publish_done does not prematurely exit receiving_sm.
 *
 * The SM is in receiving_sm waiting for PUBREL (QoS 2 inbound).  A stray
 * evt_publish_done fires (simulated via a short-timeout live() call with a
 * non-zero publish_op_start_ms).  With the fix it must not exit receiving_sm.
 */
ZTEST(sml_mqtt_concurrent, test_publish_done_does_not_exit_receiving_sm)
{
	sml_mqtt_cli::mqtt_client client;
	connect_client(client, "test_conc_txdone_rxsm");

	/* Set a very short publish timeout so that if publish_op_start_ms were
	 * accidentally set, live() would fire evt_publish_done. */
	client.set_qos_timeout_ms(5);

	/* Broker sends QoS 2 PUBLISH → SM enters receiving_sm waiting for PUBREL. */
	fake_broker_send_qos2_publish("test/conc/in/qos2",
				      reinterpret_cast<const uint8_t *>("msg"), 3,
				      0x0099u);
	client_poll_and_input(client);            /* client processes PUBLISH, sends PUBREC */
	fake_broker_absorb(FAKE_MQTT_PKT_PUBREC); /* broker absorbs PUBREC — no PUBREL sent */

	/* SM is now in receiving_sm (waiting_rel).  Wait slightly longer than
	 * the publish timeout and call live().  If publish_op_start_ms is 0
	 * (as it should be — no active publish), evt_publish_done is NOT fired
	 * and the receive timeout drives SM back via evt_receive_done. */
	k_msleep(50);
	client.live();   /* receive timeout fires evt_receive_done */

	zassert_str_equal(client.get_state(), "Connected",
			  "SM must return to Connected via receive timeout");

	/* Confirm SM is operational. */
	int ret = client.subscribe("test/conc/after/rx", MQTT_QOS_0_AT_MOST_ONCE);
	zassert_equal(ret, 0, "subscribe after receiving_sm timeout: %d", ret);
	fake_broker_process(FAKE_MQTT_PKT_SUBSCRIBE);
	client_poll_and_input(client);
	zassert_str_equal(client.get_state(), "Connected", "Connected after SUBACK");

	disconnect_client(client);
}
```

## src/test_tls_config.cpp
```c
/*
 * Copyright (c) 2025 Dean Sellers (dean@sellers.id.au)
 * SPDX-License-Identifier: MIT
 */

/*
 * TLS configuration tests.
 *
 * These tests do not require a broker: they either check fields set by init()
 * directly, or test connect() paths that return before calling mqtt_connect()
 * (i.e. early validation failures).
 *
 * TLS-specific tests are skipped when CONFIG_MQTT_LIB_TLS is not enabled.
 * The -ENOTSUP test is skipped when CONFIG_MQTT_LIB_TLS is enabled (tested
 * via the TLS build instead).
 */

#include <zephyr/ztest.h>
#include <zephyr/kernel.h>
#include <sml-mqtt-cli.hpp>

#if !defined(CONFIG_ETH_NATIVE_TAP)

/**
 * Without CONFIG_MQTT_LIB_TLS, connect() with use_tls=true must return
 * -ENOTSUP and must not attempt a network connection.
 */
ZTEST(sml_mqtt_tls, test_connect_tls_no_kconfig_returns_enotsup)
{
#if defined(CONFIG_MQTT_LIB_TLS)
	ztest_test_skip();
#else
	sml_mqtt_cli::mqtt_client client;
	int ret = client.init("tls_enotsup");
	zassert_equal(ret, 0, "init failed: %d", ret);

	ret = client.connect("127.0.0.1", 8883, true);
	zassert_equal(ret, -ENOTSUP,
		      "expected -ENOTSUP without CONFIG_MQTT_LIB_TLS, got %d", ret);
#endif
}

/**
 * With CONFIG_MQTT_LIB_TLS, connect() with use_tls=true but no TLS
 * credentials provided at init() must return -EINVAL.
 */
ZTEST(sml_mqtt_tls, test_connect_tls_without_creds_returns_einval)
{
#if !defined(CONFIG_MQTT_LIB_TLS)
	ztest_test_skip();
#else
	sml_mqtt_cli::mqtt_client client;
	int ret = client.init("tls_no_creds");
	zassert_equal(ret, 0, "init failed: %d", ret);

	/* No tls_config passed to init(); use_tls=true must be rejected early. */
	ret = client.connect("127.0.0.1", 8883, true);
	zassert_equal(ret, -EINVAL,
		      "expected -EINVAL (no creds), got %d", ret);
#endif
}

/**
 * init() with a valid tls_config must copy sec_tag IDs and peer_verify into
 * the client context so connect() can wire them into the Zephyr transport.
 */
ZTEST(sml_mqtt_tls, test_init_tls_copies_credentials)
{
#if !defined(CONFIG_MQTT_LIB_TLS)
	ztest_test_skip();
#else
	static const sec_tag_t tags[] = {42};
	sml_mqtt_cli::tls_config tls = {
		.sec_tag_list  = tags,
		.sec_tag_count = 1,
		.peer_verify   = TLS_PEER_VERIFY_REQUIRED,
	};

	sml_mqtt_cli::mqtt_client client;
	int ret = client.init("tls_copy_test", &tls);
	zassert_equal(ret, 0, "init with TLS failed: %d", ret);

	const auto &ctx = client.get_context();
	zassert_true(ctx.tls_enabled, "tls_enabled must be set");
	zassert_equal(ctx.tls_sec_tag_count, 1U, "sec_tag_count mismatch");
	zassert_equal(ctx.tls_sec_tags[0], (sec_tag_t)42, "sec_tag value mismatch");
	zassert_equal(ctx.tls_peer_verify, TLS_PEER_VERIFY_REQUIRED,
		      "peer_verify mismatch");
#endif
}

/**
 * init() with a null sec_tag_list must be rejected.
 */
ZTEST(sml_mqtt_tls, test_init_tls_null_tag_list_returns_einval)
{
#if !defined(CONFIG_MQTT_LIB_TLS)
	ztest_test_skip();
#else
	sml_mqtt_cli::tls_config tls = {
		.sec_tag_list  = nullptr,
		.sec_tag_count = 1,
		.peer_verify   = TLS_PEER_VERIFY_REQUIRED,
	};

	sml_mqtt_cli::mqtt_client client;
	int ret = client.init("tls_null_tags", &tls);
	zassert_equal(ret, -EINVAL,
		      "expected -EINVAL for null sec_tag_list, got %d", ret);
#endif
}

/**
 * init() with sec_tag_count exceeding CONFIG_SML_MQTT_CLI_MAX_TLS_SEC_TAGS
 * must be rejected.
 */
ZTEST(sml_mqtt_tls, test_init_tls_too_many_tags_returns_einval)
{
#if !defined(CONFIG_MQTT_LIB_TLS)
	ztest_test_skip();
#else
	sec_tag_t tags[CONFIG_SML_MQTT_CLI_MAX_TLS_SEC_TAGS + 1];
	memset(tags, 0, sizeof(tags));

	sml_mqtt_cli::tls_config tls = {
		.sec_tag_list  = tags,
		.sec_tag_count = CONFIG_SML_MQTT_CLI_MAX_TLS_SEC_TAGS + 1,
		.peer_verify   = TLS_PEER_VERIFY_REQUIRED,
	};

	sml_mqtt_cli::mqtt_client client;
	int ret = client.init("tls_many_tags", &tls);
	zassert_equal(ret, -EINVAL,
		      "expected -EINVAL for too many tags, got %d", ret);
#endif
}

/**
 * init() without a tls_config (plain non-TLS init) must leave tls_enabled
 * false, so a subsequent connect(..., true) returns -EINVAL.
 */
ZTEST(sml_mqtt_tls, test_init_plain_tls_disabled)
{
#if !defined(CONFIG_MQTT_LIB_TLS)
	ztest_test_skip();
#else
	sml_mqtt_cli::mqtt_client client;
	int ret = client.init("tls_plain_init");
	zassert_equal(ret, 0, "plain init failed: %d", ret);

	const auto &ctx = client.get_context();
	zassert_false(ctx.tls_enabled, "tls_enabled must be false for plain init");
#endif
}

#endif /* !CONFIG_ETH_NATIVE_TAP */
```
