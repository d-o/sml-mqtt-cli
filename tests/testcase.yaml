## tests/testcase.yaml
```yaml
# Copyright (c) 2026 Dean Sellers (dean@sellers.id.au)
# SPDX-License-Identifier: MIT
#
# Twister test descriptor for the sml-mqtt-cli test suite.
#
# Three test variants:
#
#   libraries.sml_mqtt_cli.unit (qemu_riscv32)
#     Unit tests using the in-process fake broker + Zephyr loopback.
#     No external broker, no network hardware, no root required.
#
#     west twister -T sml-mqtt-cli/tests -p qemu_riscv32 \
#       -x "ZEPHYR_MODULES=$PWD/boost-sml;$PWD/sml-mqtt-cli"
#
#   libraries.sml_mqtt_cli.tls (qemu_riscv32)
#     TLS configuration tests built with the mbedTLS overlay.
#     No external broker — tests validate credential storage and
#     transport setup only.  Requires mbedtls in ZEPHYR_MODULES.
#
#     west twister -T sml-mqtt-cli/tests -p qemu_riscv32 \
#       --test libraries.sml_mqtt_cli.tls \
#       -x "ZEPHYR_MODULES=$PWD/boost-sml;$PWD/sml-mqtt-cli;$PWD/modules/crypto/mbedtls"
#
#   libraries.sml_mqtt_cli.integration (native_sim)
#     Integration tests against a real Mosquitto broker via TAP Ethernet.
#     Requires the setup script to be run first (needs root for ip tuntap):
#
#       sudo sml-mqtt-cli/tests/scripts/run_integration_tests.sh --setup-only
#
#     Then run with Twister:
#       west twister -T sml-mqtt-cli/tests \
#         -p native_sim --test libraries.sml_mqtt_cli.integration \
#         -x "ZEPHYR_MODULES=$PWD/boost-sml;$PWD/sml-mqtt-cli"

tests:
  libraries.sml_mqtt_cli.unit:
    harness: ztest
    harness_config:
      type: one_line
      regex:
        - "PROJECT EXECUTION SUCCESSFUL"
    platform_allow: qemu_riscv32
    tags: mqtt sml networking ztest
    timeout: 120
    min_ram: 64

  libraries.sml_mqtt_cli.tls:
    harness: ztest
    harness_config:
      type: one_line
      regex:
        - "PROJECT EXECUTION SUCCESSFUL"
    platform_allow: qemu_riscv32
    tags: mqtt sml networking ztest tls
    timeout: 120
    min_ram: 128
    extra_configs:
      - CONFIG_MQTT_LIB_TLS=y
      - CONFIG_NET_SOCKETS_SOCKOPT_TLS=y
      - CONFIG_TLS_CREDENTIALS=y
      - CONFIG_HEAP_MEM_POOL_SIZE=65536
      - CONFIG_NET_TEST=y
      - CONFIG_NET_LOOPBACK=y

  libraries.sml_mqtt_cli.integration:
    harness: ztest
    harness_config:
      type: one_line
      regex:
        - "PROJECT EXECUTION SUCCESSFUL"
    platform_allow: native_sim
    tags: mqtt sml networking ztest integration
    # Broker address is compiled in via -DSML_MQTT_TEST_BROKER_HOST=<ip>.
    # Default (no override): 192.0.2.1 (host-side TAP, local Mosquitto).
    # LAN / remote: rebuild with the real broker IP, then run the script
    # with --enable-routing --no-local-broker.
    # See tests/scripts/run_integration_tests.sh --help for all use cases.
    filter: dt_compat_enabled("zephyr,posix")
    timeout: 120
    min_ram: 64
```

## zephyr/Kconfig
```kconfig
# Copyright (c) 2025 Dean Sellers (dean@sellers.id.au)
# SPDX-License-Identifier: MIT

config LIB_SML_MQTT_CLI
    bool "Include the sml-mqtt-cli library."
    default n
    depends on LIB_BOOST_SML && MQTT_LIB && !MQTT_VERSION_5_0 && CPP && STD_CPP17
    help
      Enable use of the boost::sml powered C++ MQTT client library

if LIB_SML_MQTT_CLI

config SML_MQTT_CLI_MAX_TOPIC_LEN
	int "Maximum topic length"
	default 128
	help
	  Maximum length of MQTT topic strings (including null terminator).
	  Increase this if you need to support longer topic names.

config SML_MQTT_CLI_MAX_PAYLOAD_LEN
	int "Maximum payload length"
	default 512
	help
	  Maximum length of MQTT message payload that can be stored in the
	  static buffer. Messages larger than this will be truncated.

config SML_MQTT_CLI_MAX_CLIENT_ID_LEN
	int "Maximum client ID length"
	default 64
	help
	  Maximum length of MQTT client identifier (including null terminator).

config SML_MQTT_CLI_RX_BUFFER_SIZE
	int "Receive buffer size"
	default 256
	help
	  Size of the static receive buffer for incoming MQTT packets.
	  Should be at least 128 bytes. Increase for larger messages.

config SML_MQTT_CLI_TX_BUFFER_SIZE
	int "Transmit buffer size"
	default 256
	help
	  Size of the static transmit buffer for outgoing MQTT packets.
	  Should be at least 128 bytes. Increase for larger messages.

config SML_MQTT_CLI_MAX_SUBSCRIPTIONS
	int "Maximum number of subscriptions"
	default 8
	help
	  Maximum number of topics that can be subscribed to simultaneously
	  per client instance. Each subscription uses approximately 132 bytes
	  of RAM (topic buffer + metadata).

config SML_MQTT_CLI_CONNECT_TIMEOUT_MS
	int "Connection timeout in milliseconds"
	default 5000
	help
	  Maximum time to wait for MQTT connection acknowledgment.
	  If no CONNACK is received within this time, the connection
	  attempt is aborted and returns to Disconnected state.

config SML_MQTT_CLI_KEEPALIVE_SEC
	int "Keep-alive interval in seconds"
	default 60
	help
	  MQTT keep-alive interval sent in the CONNECT packet.
	  The broker will close the connection if no messages are
	  received within 1.5x this interval. Set to 0 to disable.

config SML_MQTT_CLI_PUBLISH_TIMEOUT_MS
	int "QoS publish/receive operation timeout in milliseconds"
	default 5000
	help
	  Maximum time to wait for a QoS 1/2 protocol acknowledgment
	  (PUBACK, PUBREC, PUBCOMP, or PUBREL for incoming QoS 2).
	  When live() is called and the elapsed time exceeds this value,
	  the in-flight operation is abandoned and the state machine
	  returns to Connected.  Set to 0 to disable timeouts.

endif # LIB_SML_MQTT_CLI
```
